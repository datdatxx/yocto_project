## rpi-build/conf/bblayers.conf
```bitbake
# POKY_BBLAYERS_CONF_VERSION is increased each time build/conf/bblayers.conf
# changes incompatibly
POKY_BBLAYERS_CONF_VERSION = "2"

BBPATH = "${TOPDIR}"
BBFILES ?= ""

BBLAYERS ?= " \
  /home/dat/embedded_workspace/yocto/poky/meta \
  /home/dat/embedded_workspace/yocto/poky/meta-poky \
  /home/dat/embedded_workspace/yocto/poky/meta-yocto-bsp \
  /home/dat/embedded_workspace/yocto/meta-raspberrypi \
  /home/dat/embedded_workspace/yocto/meta-openembedded/meta-oe \
  /home/dat/embedded_workspace/yocto/meta-openembedded/meta-python \
  "
```
